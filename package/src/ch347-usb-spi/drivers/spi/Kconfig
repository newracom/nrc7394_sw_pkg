## package/src/ch347-usb-spi/drivers/spi/Kconfig
```kconfig
config SPI_CH347
	tristate "CH347 SPI controller"
	depends on USB || GPIOLIB || COMPILE_TEST
	help
	  CH347 supports UART/SPI/I2C/JTAG/GPIO. 
	  This driver supports SPI/GPIO.
```
